;** ###################################################################
;**     THIS MODULE IS GENERATED BY THE TOOL. DO NOT MODIFY IT.
;**     Contents  :
;**         Function "MCU_init" initializes selected peripherals.
;**            By default it is empty. Select "Generate Code"
;**            to produce initialization code.
;**
;**     Copyright : 1997 - 2010 Freescale Semiconductor, Inc. All Rights Reserved.
;**     
;**     http      : www.freescale.com
;**     mail      : support@freescale.com
;** ###################################################################


; User declarations and definitions
;   Code, declarations and definitions here will be preserved during code generation
; End of user declarations and definitions

;** ===================================================================
;**     Method      :  MCU_init
;**
;**     Description :
;**         Device initialization code for selected peripherals.
;** ===================================================================
MCU_init:
; Select "Generate Code" to create initialization code here
        RTC



_code_currPos: EQU *
        ORG     $FFFE                  ; Reset interrupt vector
_vect:
        DC.W   _Startup

        ORG     _code_currPos          ; restore position for code

;** ###################################################################
;**
;**     This file was created by Processor Expert
;**     for the Freescale HCS12 series of microcontrollers.
;**
;** ###################################################################
